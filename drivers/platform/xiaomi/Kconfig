## drivers/platform/xiaomi/Kconfig
```kconfig
# Xiaomi configuration options

config MACH_XIAOMI_MSM8937
	bool "Xiaomi MSM8937"
	depends on ARCH_MSM8937
	help
	  Support for MSM8937 Xiaomi variants

menu "Xiaomi board selection"

config MACH_XIAOMI_PRADA
	bool "Prada board"
	select MACH_XIAOMI_MSM8937
	help
	  Support for Redmi 4

endmenu
```
